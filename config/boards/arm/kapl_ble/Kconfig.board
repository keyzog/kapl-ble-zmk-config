## config/boards/arm/kapl_ble/Kconfig.board
```kconfig
#
# Copyright (c) 2021 The ZMK Contributors
# SPDX-License-Identifier: MIT
#

config BOARD_KAPL_BLE_LEFT
	bool "kapl_ble_left"
	depends on SOC_NRF52840_QIAA

config BOARD_KAPL_BLE_RIGHT
	bool "kapl_ble_right"
	depends on SOC_NRF52840_QIAA
```

## config/boards/arm/kapl_ble/Kconfig.defconfig
```kconfig
#
# Copyright (c) 2021 The ZMK Contributors
# SPDX-License-Identifier: MIT
#

if BOARD_KAPL_BLE_LEFT

config ZMK_KEYBOARD_NAME
	default "Kapl BLE"

config ZMK_SPLIT_ROLE_CENTRAL
	default y

endif # BOARD_KAPL_BLE_LEFT


if BOARD_KAPL_BLE_LEFT || BOARD_KAPL_BLE_RIGHT

if USB_DEVICE_STACK

config USB_NRFX
	default y

endif # USB_DEVICE_STACK

config BOARD
	default "kapl_ble"

config BT_CTLR
	default BT

config ZMK_SPLIT
	default y

config ZMK_BLE
	default y

config ZMK_USB
	default y

endif # BOARD_KAPL_BLE_LEFT || BOARD_KAPL_BLE_RIGHT
```
